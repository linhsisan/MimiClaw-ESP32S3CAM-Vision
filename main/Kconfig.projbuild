## main/Kconfig.projbuild
```kconfig
menu "Display Configuration"
    choice DISPLAY_MODEL
        prompt "Select TFT Display Model"
        default USE_ILI9341

        config USE_ILI9341
            bool "ILI9341 (Default)"
        config USE_ST7789
            bool "ST7789 (Specific settings)"
    endchoice
endmenu
```

## sdkconfig.defaults
```kconfig
# MimiClaw - Common Default Configuration
# Target-specific settings are in sdkconfig.defaults.esp32s3

# Network hostname
CONFIG_LWIP_LOCAL_HOSTNAME="mimiclaw"

# SPIFFS: increase max filename length (default 32 is too short for session files)
CONFIG_SPIFFS_OBJ_NAME_LEN=64

CONFIG_FREERTOS_HZ=1000

CONFIG_LV_FONT_MONTSERRAT_20=y
CONFIG_LV_FONT_MONTSERRAT_32=y


CONFIG_ESPTOOLPY_FLASHSIZE_16MB=y
CONFIG_PARTITION_TABLE_CUSTOM=y
CONFIG_PARTITION_TABLE_CUSTOM_FILENAME="partitions.csv"
CONFIG_PARTITION_TABLE_FILENAME="partitions.csv"
```
